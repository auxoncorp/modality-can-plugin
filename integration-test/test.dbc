VERSION "0.1"

NS_ :

BS_:

BU_: test_node0 test_node1

BO_ 1 test_msg0: 8 test_node0
 SG_ u4_le : 0|4@1+ (1,0) [0|0] "ticks"  test_node0
 SG_ u4_be : 7|4@0+ (1,0) [0|0] ""  test_node0
 SG_ i4_le : 8|4@1- (1,0) [0|0] ""  test_node0
 SG_ i4_be : 15|4@0- (1,0) [0|0] ""  test_node0
 SG_ float32_le : 16|32@1- (1,0) [0|0] ""  test_node0
 SG_ i8_le_so : 48|8@1- (2,10) [0|0] ""  test_node0
 SG_ muxer0 M : 56|1@1+ (1,0) [0|0] ""  test_node0
 SG_ muxed_a m0 : 57|4@1- (1,0) [0|0] ""  test_node0
 SG_ muxed_b m1 : 60|4@0- (1,0) [0|0] ""  test_node0
 SG_ flag0 : 61|1@1+ (1,0) [0|0] ""  test_node0
 SG_ enum0 : 62|2@1+ (1,0) [0|0] ""  test_node0

BO_ 2 test_msg1: 8 test_node1
 SG_ double_be : 7|64@0- (1,0) [0|0] "" Vector__XXX

CM_ BU_ test_node0 "Test node 0";
CM_ BU_ test_node1 "Test node 1";
CM_ BO_ 1 "Test msg 0";
CM_ SG_ 1 u4_le "u4_le comment";
VAL_ 1 enum0 0 "value0" 1 "value1" 2 "value2" 3 "value3" ;
SIG_VALTYPE_ 1 float32_le : 1;
SIG_VALTYPE_ 2 double_be : 2;
